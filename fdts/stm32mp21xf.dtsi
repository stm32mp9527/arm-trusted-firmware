// SPDX-License-Identifier: (GPL-2.0-only OR BSD-3-Clause)
/*
 * Copyright (C) STMicroelectronics 2024 - All Rights Reserved
 * Author: Alexandre Torgue <alexandre.torgue@foss.st.com> for STMicroelectronics.
 */

/ {
        soc@0 {
		saes: saes@42030c00 {
			compatible = "st,stm32-saes";
			reg = <0x42030c00 0x400>;
			clocks = <&rcc CK_BUS_SAES>;
			resets = <&rcc SAES_R>;
			status = "disabled";
		};
	};
};
